/**********************************Copyright (c)********************************
**                            ZhengZhou GuangLi Tech CO.,LTD
**                                All rights reserved.
**
**----------------------------------项目信息------------------------------------
** 文件名称： syserror.c
** 说    明： 运行过程中出现错误的错误标志设置程序和管理程序
**
**----------------------------------版本历史------------------------------------
** 版本号	修改者	完成日期		内容
** V1.0
*******************************************************************************/

/*
*********************************************************************************************************
*                                             包含头文件
*********************************************************************************************************
*/
#include "sysremerror.h"
#include <string.h>

/*
*********************************************************************************************************
*                                           内部类型和宏定义
*********************************************************************************************************
*/
/**************异常信息存储结构**************************/
/* 为每种错误设置一字节错误次数寄存器 <=255  */
static uint8_t cntErrBuf[ERR_END];

static const struct
{
    uint16_t code;
    uint8_t maxnum;
    const char *pstr;
} errCodeList[ERR_END] = {
    [COM0RxBuf_OV] = {300, 1, "UART0 RX异常"},       /*   端口0接收缓冲区溢出标志   */
    [COM1RxBuf_OV] = {301, 1, "UART1 RX异常"},       /*   端口1接收缓冲区溢出标志   */
    [COM2RxBuf_OV] = {302, 1, "UART2 RX异常"},       /*   端口2接收缓冲区溢出标志   */
    [COM3RxBuf_OV] = {303, 1, "UART3 RX异常"},       /*   端口3接收缓冲区溢出标志   */
    [COM4RxBuf_OV] = {304, 1, "UART4 RX异常"},       /*   端口4接收缓冲区溢出标志   */
    [Err_FM31256_NOACK] = {305, 1, "EEPRom 异常"},   /*   FM31256无应答   */
    [Err_MALLOC] = {306, 1, "Heap 异常"},            /*   动态内存分配失败  */
    [ERR_FPGA_COMM] = {313, 1, "FPGA 通讯异常"},     /*   与FPGA板通讯异常错误   */
    [ERR_O2REPSEN_COMM] = {315, 5, "O2 通讯异常"},   /*   氧气补偿传感器通讯错误 */
    [ERR_O2REPSEN_SIGNAL] = {420, 5, "O2 信号异常"}, /*  氧气补偿传感器 信号检测异常	*/
    [ERR_ADS_COMM] = {316, 50, "AD 通讯异常"},       /*  ADS1115通讯异常 	*/
    [ERR_H2_COMM] = {350, 5, "H2 通讯异常"},         /*  氢气通讯异常 	*/
    [ERR_C3H6_COMM] = {317, 10, "C3H6 通讯异常"},    /*  丙烯通讯异常 	*/
    [ERR_OUTTEMPRANGE] = {310, 1, "温度超范围"},     /*  光声池温度超范围 	*/
    [ERR_HEATING] = {103, 1, "预热中"},              /* 预热中*/
    [ERR_DZFBUSY] = {5, 1, "设备忙"},                /* 设备忙*/
    [ERR_TCTRL_COMM] = {311, 5, "温控通讯异常"},     /* 温控通讯异常*/
    [ERR_LSC_COMM] = {312, 1, "湿度读取异常"},
    [ERR_COMM_DS18B20] = {320, 15, "激光器温度异常"},
    [ERR_HUMI_VALUE] = {407, 1, "湿度超上限"},
    [ERR_CO2_ALERT] = {409, 1, "CO2超量程"},
    [ERR_COMM_CAN] = {601, 10, "CAN 通讯异常"},
    [ERR_MEAS_C2H2] = {1, 1, "乙炔传感器测量异常"}, /*测量异常*/
    [ERR_MEAS_CH4] = {2, 1, "甲烷传感器测量异常"},
    [ERR_MEAS_CO2] = {3, 1, "二氧化碳传感器测量异常"},
    [ERR_MEAS_O2] = {4, 1, "氧气传感器测量异常"},
    [ERR_MEAS_CO] = {5, 1, "一氧化碳传感器测量异常"},
    [ERR_MEAS_C2H4] = {6, 1, "乙烯传感器测量异常"},
    [ERR_MEAS_C2H6] = {7, 1, "乙烷测量异常"},
    [ERR_MEAS_H2] = {8, 1, "氢气测量异常"},
    [ERR_MEAS_N2] = {9, 1, "氮气测量异常"},
    [ERR_CELLTEMP] = {314, 5, "气室温度异常"}, /*!< 气室温度异常 */

};

/*
*********************************************************************************************************
*                                      内部变量定义
*********************************************************************************************************
*/

/*
*********************************************************************************************************
*                                      内部函数原型声明
*********************************************************************************************************
*/

/*
*********************************************************************************************************
*                                      函数原型
*********************************************************************************************************
*/

/**********************************************************************************
** 函数名称:
** 功    能:
** 输入参数:
** 输出参数:
** 返    回:
***********************************************************************************/
void ErrorManageInit(void)
{
}

/**********************************************************************************
** 函数名称: ErrorFlagSet
** 功    能:
** 输入参数:
** 输出参数:
** 返    回:
***********************************************************************************/
int ErrorFlagSet(ERROR_ENUM_T err)
{
    uint8_t rs;
    if (err >= ERR_END)
        return 0;

    if (cntErrBuf[err] < errCodeList[err].maxnum)
        cntErrBuf[err]++;

    rs = cntErrBuf[err] < errCodeList[err].maxnum ? 0 : 1;

    return rs;
}

/**********************************************************************************
** 函数名称: ErrorFlagMark
** 功    能:
** 输入参数:
** 输出参数:
** 返    回:
***********************************************************************************/
void ErrorFlagMark(ERROR_ENUM_T err)
{
    if (err >= ERR_END)
        return;

    cntErrBuf[err] = errCodeList[err].maxnum;
}

/*
*********************************************************************************
** 函数名称:
** 功    能:
** 输入参数:
** 输出参数:
** 返    回:
**********************************************************************************
*/
void ErrorFlagClear(ERROR_ENUM_T err)
{
    if (err >= ERR_END)
        return;

    cntErrBuf[err] = 0;
}
/*
*********************************************************************************
** 函数名称:
** 功    能:
** 输入参数:
** 输出参数:
** 返    回:
**********************************************************************************
*/
int ErrorCheck(ERROR_ENUM_T err)
{
    if (cntErrBuf[err] < errCodeList[err].maxnum)
        return 0;
    else
        return 1;
}

/*
*********************************************************************************
** 函数名称:
** 功    能:
** 输入参数:
** 输出参数:
** 返    回:
**********************************************************************************
*/
uint16_t ErrorCodeGet(ERROR_ENUM_T err)
{
    return errCodeList[err].code;
}

/*
*********************************************************************************
** 函数名称:
** 功    能:
** 输入参数:
** 输出参数:
** 返    回:
**********************************************************************************
*/
const char *ErrorNameGet(ERROR_ENUM_T err)
{
    return errCodeList[err].pstr;
}

/*
*********************************************************************************
** 函数名称:
** 功    能:
** 输入参数:
** 输出参数:
** 返    回:
**********************************************************************************
*/
int ErrorCodeNumGet(void)
{
    int i, n;

    n = 0;
    for (i = 0; i < ERR_END; i++)
    {
        if (cntErrBuf[i] >= errCodeList[i].maxnum)
        {
            n++;
        }
    }

    return n;
}

/*
*********************************************************************************
** 函数名称:
** 功    能:
** 输入参数:
** 输出参数:
** 返    回:
**********************************************************************************
*/
int ErrorCodeListGet(uint16_t *pbuf)
{
    int i, n;

    n = 0;
    for (i = 0; i < ERR_END; i++)
    {
        if (cntErrBuf[i] >= errCodeList[i].maxnum)
        {
            *pbuf++ = errCodeList[i].code;
            n++;
        }
    }

    return n;
}
/*
*********************************************************************************
** 函数名称:
** 功    能:
** 输入参数:
** 输出参数:
** 返    回:
**********************************************************************************
*/
int ErrorGetCodeList(uint8_t *pbuf)
{
    int i, n;
    uint16_t code;

    n = 0;
    for (i = 0; i < ERR_END; i++)
    {
        if (cntErrBuf[i] >= errCodeList[i].maxnum)
        {
            code = errCodeList[i].code;
            *pbuf++ = (code >> 0) & 0xff;
            *pbuf++ = (code >> 8) & 0xff;

            n++;
        }
    }

    return n;
}

/***************************** END OF FILE ************************************/
