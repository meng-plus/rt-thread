/**
 * @file fm31XX.c
 * @author mengplus (chengmeng_2@outlook.com)
 * @brief
 * @version 0.1
 * @date 2023-07-07
 *
 * @copyright Copyright (c) 2023
 *
 */
#include "fm31xx.h"
#include <rtthread.h>
#define LOG_TAG __FILE__
#define LOG_LVL LOG_LVL_DBG
#include "ulog.h"
/*=============================================
==
===============================================*/
// Fm31xx_port.c
void fm31xx_hw_i2c_init();

int Fm31xxWriteReg(uint8_t reg, uint8_t *pdt, uint8_t len);
int Fm31xxReadReg(uint8_t reg, uint8_t *pdt, uint8_t len);
/**********************************************************************************
** 函数名称:
** 功    能:
** 输入参数:
** 输出参数:
** 返    回:
***********************************************************************************/
int Fm31xxInit(void)
{
    fm31xx_hw_i2c_init();
    RTCEnable(1);
    return 0;
}
INIT_DEVICE_EXPORT(Fm31xxInit);


/**********************************************************************************
** 函数名称:
** 功    能:
** 输入参数:
** 输出参数:
** 返    回:
***********************************************************************************/
uint8_t BcdToHex(uint8_t k)
{
    k -= ((k >> 4) * 6);
    return k;
}
/**********************************************************************************
** 函数名称:
** 功    能:
** 输入参数:
** 输出参数:
** 返    回:
***********************************************************************************/
uint8_t HexToBcd(uint8_t k)
{
    k = ((k / 10) << 4) | (k % 10);
    return k;
}
/**********************************************************************************
** 函数名称: WDogFeed
** 功    能: WatchDog复位
** 输入参数: void
** 输出参数: 无
** 返    回: void
***********************************************************************************/
int WDogFeed(void)
{
    uint8_t ch = 0x0a;

    return Fm31xxWriteReg(0x09, &ch, 1);
}

/**********************************************************************************
** 函数名称:
** 功    能:
** 输入参数:
** 输出参数:
** 返    回:
***********************************************************************************/
int WDogStart(uint16_t m)
{
    uint8_t ch;
    int res = 0;

    // 复位看门狗
    ch = 0x0a;
    res |= Fm31xxWriteReg(0x09, &ch, 1);

    // 启动看门狗
    m /= 100;
    if (m > 30)
        m = 30;

    ch = 0x80 | m;
    res |= Fm31xxWriteReg(0x0a, &ch, 1);
    /* 看门狗复位时间
            0	100ms
            1	100ms
            2	200ms
            3	300ms
            .........
            30	3000ms
            31	disable counter
    */

    // 再次复位看门狗
    ch = 0x0a;
    res |= Fm31xxWriteReg(0x09, &ch, 1);

    return res;
}

/**********************************************************************************
** 函数名称: WDogStop
** 功    能: 关闭看门狗计数器
** 输入参数: void
** 输出参数: 无
** 返    回: void
***********************************************************************************/
int WDogStop(void)
{
    uint8_t ch = 31;

    return Fm31xxWriteReg(0x0a, &ch, 1);
}

/**********************************************************************************
** 函数名称:
** 功    能:
** 输入参数:
** 输出参数:
** 返    回:
***********************************************************************************/
int RTCEnable(uint8_t ben)
{
    int res = 0;
    uint8_t ch;

    res |= Fm31xxReadReg(0x01, &ch, 1);

    if (ben == 0)
        ch |= (1 << 7);
    else
        ch &= (~(1 << 7));
    res |= Fm31xxWriteReg(0x01, &ch, 1);

    return res;
}

/**********************************************************************************
** 函数名称:
** 功    能:
** 输入参数:
** 输出参数:
** 返    回:
***********************************************************************************/
int RTCCalMode(uint8_t ben)
{
    int res = 0;
    uint8_t ch;

    res |= Fm31xxReadReg(0x00, &ch, 1);

    if (ben == 0)
        ch &= (~(1 << 2));
    else
        ch |= (1 << 2);
    res |= Fm31xxWriteReg(0x01, &ch, 1);

    return res;
}

/**********************************************************************************
** 函数名称:
** 功    能:
** 输入参数:
** 输出参数:
** 返    回:
***********************************************************************************/
int RTCCalGet(int8_t *cal)
{
    int res = 0;
    uint8_t ch;

    res |= Fm31xxReadReg(0x01, &ch, 1);

    *cal = (int8_t)(ch & 0x1f);
    if ((ch & (1 << 5)) != 0)
        *cal = -(*cal);

    return res;
}

/**********************************************************************************
** 函数名称:
** 功    能:
** 输入参数:
** 输出参数:
** 返    回:
***********************************************************************************/
int RTCCalSet(int8_t cal)
{
    int res = 0;
    uint8_t ch;

    res |= Fm31xxReadReg(0x01, &ch, 1);

    // 符号
    if (cal < 0)
    {
        cal = -cal;
        ch |= (1 << 5);
    }

    //
    if (cal > 0x1f)
        cal = 0x1f;

    ch = (ch & (~0x1f)) | cal;
    res |= Fm31xxWriteReg(0x01, &ch, 1);

    return res;
}

/**********************************************************************************
** 函数名称:
** 功    能: 向RTC中写入日期时间
** 输入参数:
** 输出参数:
** 返    回:
***********************************************************************************/
int RTCWriteTime(RTC_TIME *dtm)
{
    uint8_t buf[7];
    int err;

    // 冻结RTC时间寄存器更新
    buf[0] = 0x02;
    Fm31xxWriteReg(0x00, buf, 1);

    // 写入RTC时间寄存器
    buf[0] = HexToBcd(dtm->second);
    buf[1] = HexToBcd(dtm->minute);
    buf[2] = HexToBcd(dtm->hour);
    buf[3] = HexToBcd(dtm->week);
    buf[4] = HexToBcd(dtm->date);
    buf[5] = HexToBcd(dtm->month);
    buf[6] = HexToBcd(dtm->year);

    err = Fm31xxWriteReg(0x02, buf, 7);

    // 允许更新RTC时间寄存器
    buf[0] = 0x00;
    Fm31xxWriteReg(0x00, buf, 1);

    return err;
}

/**********************************************************************************
** 函数名称:
** 功    能: RTC读取时间
** 输入参数: void
** 输出参数: dt--从RTC读到的时间
** 返    回:
***********************************************************************************/
int RTCReadTime(RTC_TIME *dtm)
{
    uint8_t i = 0;
    uint8_t buf[7];

    // 复制RTC中的日期时间
    buf[0] = 0x01;
    Fm31xxWriteReg(0x00, buf, 1);

    i = Fm31xxReadReg(0x02, buf, 7);

    if (i == 0)
    {
        dtm->second = BcdToHex(buf[0]);
        dtm->minute = BcdToHex(buf[1]);
        dtm->hour = BcdToHex(buf[2]);
        dtm->week = BcdToHex(buf[3]);
        dtm->date = BcdToHex(buf[4]);
        dtm->month = BcdToHex(buf[5]);
        dtm->year = BcdToHex(buf[6]);
    }

    // 复位RTC读寄存器状态
    buf[0] = 0x00;
    Fm31xxWriteReg(0x00, buf, 1);

    return 0;
}
/**********************************************************************************
** 函数名称:
** 功    能:
** 输入参数:
** 输出参数:
** 返    回:
***********************************************************************************/
int E2PromProtect(uint8_t ben)
{
    uint8_t ch;

    // 去除Flash保护
    if (ben == 0)
        ch = 0x00;
    else
        ch = 0x18;
    return Fm31xxWriteReg(0x0b, &ch, 1);
}
