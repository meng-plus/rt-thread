## bsp/hc32l196/board/Kconfig
```kconfig
menu "Hardware Drivers Config"

config MCU_HC32L196
    bool
    select ARCH_ARM_CORTEX_M0
    select RT_USING_COMPONENTS_INIT
    select RT_USING_USER_MAIN
    default y

menu "Onboard Peripheral Drivers"
    config BSP_USING_FAL_ON_CHIP
        bool "Enable Fal on chip"
        select RT_USING_PIN
        default y
endmenu

menu "On-chip Peripheral Drivers"
    config BSP_USING_GPIO
        bool "Enable GPIO"
        select RT_USING_PIN
        default y

    menuconfig BSP_USING_UART
        bool "Enable UART"
        default y
        select RT_USING_SERIAL
        if BSP_USING_UART
            config BSP_USING_UART0
                bool "Enable UART0"
                default y

            config BSP_USING_UART1
                bool "Enable UART1"
                default n
        endif
    menuconfig BSP_USING_SOFT_SPI
        bool "Enable SOFT SPI"
        default y
        select RT_USING_SPI
        if BSP_USING_SOFT_SPI
            config BSP_USING_SOFT_SPI1
                bool "Enable SOFT SPI1"
                default y
                if BSP_USING_SOFT_SPI1
                    comment "Notice: PA0 --> 0; PA1--> 1; PA2 --> 2"
                    config BSP_S_SPI1_SCK_PIN
                        int "sspi1 SCL pin number"
                        range 0 79
                        default 0
                    config BSP_S_SPI1_MOSI_PIN
                        int "sspi1 MISO pin number"
                        range 0 79
                        default 2
                    config BSP_S_SPI1_MISO_PIN
                        int "sspi1 MOSI pin number"
                        range 1 79
                        default 1
                endif
            # config BSP_USING_SOFT_SPI2
            #     bool "Enable SOFT SPI2"
            #     default n
        endif

endmenu

# menu "Board extended module Drivers"

# endmenu

endmenu
```

## bsp/lpc408x/drivers/Kconfig
```kconfig
menu "Hardware Drivers Config"

    menu "On-chip Peripheral Drivers"
        config BSP_USING_HWTIMER0
            bool "Using timer0"
            select RT_USING_HWTIMER
            default n
        config BSP_USING_EEPROM_ONCHIP
            bool "Enable On-chip EEPROM"
            default n
            config BSP_USING_FAL_SAMPLE
                bool "Enable FAL for test"
                default n
        config BSP_USING_FLASH_ONCHIP
            bool "Enable On-chip Flash"
            default n
        config BSP_USING_ADC
            bool "Using ADC"
            select RT_USING_ADC
            default n
        menu "SPI config"
            config BSP_USING_SPI
            bool "Enable SPI"
            select RT_USING_SPI
            default n
            if BSP_USING_SPI
                config BSP_USING_SPI1
                bool "Enable SPI1"
                default n
                config BSP_USING_SPI2
                bool "Enable SPI2"
                default n
            endif
            config BSP_USING_SOFT_SPI
            bool "Enable SOFT SPI"
            select RT_USING_SPI
            select RT_USING_SPI_BITOPS
            select RT_USING_PIN
            default n
            if BSP_USING_SOFT_SPI
                config BSP_USING_SOFT_SPI1
                bool "Enable sspi1"
                default n
                if BSP_USING_SOFT_SPI1
                    config BSP_S_SPI1_SCK_PIN
                    int "Select sck"
                    default 86
                    config BSP_S_SPI1_MOSI_PIN
                    int "Select mosi"
                    default 91
                    config BSP_S_SPI1_MISO_PIN
                    int "Select miso"
                    default 90
                endif

                config BSP_USING_SOFT_SPI2
                bool "Enable sspi2"
                default n
                if BSP_USING_SOFT_SPI2
                    config BSP_S_SPI2_SCK_PIN
                    int "Select sck"
                    default 7
                    config BSP_S_SPI2_MOSI_PIN
                    int "Select mosi"
                    default 9
                    config BSP_S_SPI2_MISO_PIN
                    int "Select miso"
                    default 8
                endif
                config BSP_USING_SOFT_SPI3
                bool "Enable sspi3"
                default n
                if BSP_USING_SOFT_SPI3
                    config BSP_S_SPI3_SCK_PIN
                    int "Select sck"
                    default 46
                    config BSP_S_SPI3_MOSI_PIN
                    int "Select mosi"
                    default 156
                    config BSP_S_SPI3_MISO_PIN
                    int "Select miso"
                    default 40
                endif
            endif
        endmenu
        config BSP_USING_UART
            bool "Enable UART"
            select RT_USING_SERIAL
            default n
            if BSP_USING_UART
                config BSP_USING_UART0
                    bool "Enable UART0"
                    default y
                config BSP_USING_UART1
                    bool "Enable UART1"
                    default n
                config BSP_USING_UART2
                    bool "Enable UART2"
                    default n
                config BSP_USING_UART3
                    bool "Enable UART3"
                    default n
                config BSP_USING_UART4
                    bool "Enable UART4"
                    default n
           endif
    endmenu

    menu "On Core Board Peripheral Drivers"

        config BSP_USING_SDRAM
            bool "Enable SDRAM"
            default y
        config BSP_USING_EXTFLASH
            bool "Enable extflash"
            default y

        config BSP_USING_SPFI
            bool "Enable QSPI S25FL032"
            select RT_USING_FAL
            depends on BSP_USING_EXTFLASH
            default n

        config BSP_USING_FM31XX
            bool "Enable Fm31xx(wdg e2prom RTC)"
            select RT_USING_RTC
            default n
            if BSP_USING_FM31XX
            config BSP_USING_FM31XX_SHELL
                bool "Enabel shell"
                default n

            config BSP_USING_WDT
                bool "Enabel watchdog"
                select RT_USING_WDT
                default n
            endif

        config BSP_USING_ADXL345
            bool "Enable ADXL345"
            default n
            config BSP_USING_ADXL345_SHELL
            bool "Enabel shell"
                depends on BSP_USING_ADXL345
            default n
    endmenu

menu "Board extended module Drivers"
    choice
        prompt "Board select"
        default BSP_USING_BOARD_9903Z1V2

        config BSP_USING_BOARD_9903Z1V2
        bool "9903Z1V2"
        config BSP_USING_BOARD_315101Z2V2
        bool "315101Z2V2"
        config BSP_USING_BOARD_370792Z1V1_20230828
        bool "370792Z1V1(20230828)"
    endchoice

    choice
        prompt "Flash database select"
        default BSP_USING_FLASHDB

        config BSP_USING_EASYFLASH
        bool "easyFlash"
        config BSP_USING_FLASHDB
        bool "flash db"
    endchoice

        if BSP_USING_EASYFLASH
            config BSP_USING_EASYFLASH
                select PKG_USING_EASYFLASH
                select RT_USING_FAL
         endif
        if BSP_USING_FLASHDB
            config BSP_USING_FLASHDB
                select PKG_USING_FLASHDB
                select RT_USING_FAL
        endif
        config BSP_USRING_FAL_NAME
            string "Fal part name"
            depends on  BSP_USING_EASYFLASH || BSP_USING_FLASHDB
            default "easyflash"


        config BSP_USING_ADS1115
        bool "Enable ADS1115"
            depends on BSP_USING_BOARD_9903Z1V2 || BSP_USING_BOARD_315101Z2V2
        default n
        config BSP_USING_ADS1115_SHELL
        bool "Enabel shell"
            depends on BSP_USING_ADS1115
        default n

        config BSP_USING_LCD
            bool "Enable LCD"
            depends on BSP_USING_BOARD_9903Z1V2 || BSP_USING_BOARD_315101Z2V2 ||BSP_USING_BOARD_370792Z1V1_20230828
            default n
            if BSP_USING_LCD
                config BSP_LCD_WIDTH
                    int "screen width"
                    default 480
                config BSP_LCD_HEIGHT
                    int "screen height"
                    default 272
                config BSP_LCD_BPP
                int "color depth"
                default 16
            endif
        config BSP_USING_KEYIRD
            bool "Enable KeyIrd"
            depends on BSP_USING_BOARD_9903Z1V2 || BSP_USING_BOARD_315101Z2V2 ||BSP_USING_BOARD_370792Z1V1_20230828
            default n
endmenu
menu "Board extended packages"
        config PKG_USING_PROTOCOL
            bool "Enable Protocol framework"
            default n
           help
                user protocol
endmenu
endmenu
```

## bsp/stm32/stm32f405-YRH300DS/board/Kconfig
```kconfig
menu "Hardware Drivers Config"

config SOC_STM32F405RG
    bool
    select SOC_SERIES_STM32F4
    select RT_USING_COMPONENTS_INIT
    select RT_USING_USER_MAIN
    default y

menu "Onboard Peripheral Drivers"

endmenu

menu "On-chip Peripheral Drivers"

    config BSP_USING_GPIO
        bool "Enable GPIO"
        select RT_USING_PIN
        default y

    menuconfig BSP_USING_UART
        bool "Enable UART"
        default y
        select RT_USING_SERIAL
        if BSP_USING_UART
            config BSP_USING_UART2
                bool "Enable UART2"
                default y
            if BSP_USING_UART2 && RT_USING_SERIAL_V2
                config BSP_UART2_RX_BUFSIZE
                int "RxBuff size"
                default 64
                config BSP_UART2_TX_BUFSIZE
                int "txBuff size"
                default 64
            endif
            config BSP_UART2_RX_USING_DMA
                bool "Enable UART2 RX DMA"
                depends on BSP_USING_UART2 && RT_SERIAL_USING_DMA
                default n
        endif
    menuconfig BSP_USING_SPI
        bool "Enable SPI"
        default y
        select RT_USING_SPI
        if BSP_USING_SPI
            config BSP_USING_SPI1
            bool "Enable  SPI1"
            default y

            config BSP_USING_SPI2
            bool "Enable  SPI2"
            default y
        endif
    menuconfig BSP_USING_I2C
        bool "Enable I2C"
        default y
        select RT_USING_I2C_BITOPS
        select RT_USING_I2C
        if BSP_USING_I2C
            config BSP_USING_I2C1
            bool "Enable  I2C1"
            default y
            config BSP_I2C1_SCL_PIN
                hex "scl pin"
                default 0x16
                depends on  BSP_USING_I2C1

            config BSP_I2C1_SDA_PIN
                hex "sda pin"
                default 0x17
                depends on  BSP_USING_I2C1

            config BSP_USING_I2C2
            bool "Enable  I2C2"
            default y
            config BSP_I2C2_SCL_PIN
                hex "scl pin"
                default 0x1A
                depends on  BSP_USING_I2C2

            config BSP_I2C2_SDA_PIN
                hex "sda pin"
                default 0x1B
                depends on  BSP_USING_I2C2

        endif
        config BSP_USING_ONCHIP_RTC
            bool "Enable RTC"
            default y
    source "../libraries/HAL_Drivers/Kconfig"

endmenu

menu "Board extended module Drivers"

endmenu

endmenu
```
